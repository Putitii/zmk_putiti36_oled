## boards/shields/putiti36_oled/Kconfig.shield
```kconfig
# Copyright (c) 2020 The ZMK Contributors
# SPDX-License-Identifier: MIT

config SHIELD_PUTITI36_OLED
    def_bool $(shields_list_contains,putiti36_oled)
```

## config/boards/shields/putiti36_choc/Kconfig.defconfig
```kconfig
# Copyright (c) 2020 The ZMK Contributors
# SPDX-License-Identifier: MIT

if SHIELD_PUTITI36_CHOC

config ZMK_KEYBOARD_NAME
	default "putiti36_choc"
endif
```

## config/boards/shields/putiti36_choc/Kconfig.shield
```kconfig
# Copyright (c) 2020 The ZMK Contributors
# SPDX-License-Identifier: MIT

config SHIELD_PUTITI36_CHOC
    def_bool $(shields_list_contains,putiti36_choc)
```

## config/boards/shields/putiti36_oled/Kconfig.defconfig
```kconfig
# Copyright (c) 2020 The ZMK Contributors
# SPDX-License-Identifier: MIT

if SHIELD_PUTITI36_OLED

config ZMK_KEYBOARD_NAME
    #default "chiffre_OLED"
	default "putiti36_oled"
endif

if ZMK_DISPLAY
config I2C
	default y
config SSD1306
	default y
config SSD1306_REVERSE_MODE
	default y
endif # ZMK_DISPLAY


if LVGL
config LVGL_VDB_SIZE
	default 64
config LVGL_DPI
	default 148
config LVGL_BITS_PER_PIXEL
	default 1
choice LVGL_COLOR_DEPTH
	default LVGL_COLOR_DEPTH_1
endchoice
endif # LVGL
```
